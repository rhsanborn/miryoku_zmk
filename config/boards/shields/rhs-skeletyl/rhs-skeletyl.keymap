// Copyright 2024 Manna Harbour
// https://github.com/manna-harbour/miryoku

#include "../../../../miryoku/custom_config.h"
#include "../../../../miryoku/mapping/36/minidox.h"
#include "../../../../miryoku/miryoku.dtsi"
